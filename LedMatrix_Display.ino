/*
  LedMatrix_display.ino
  
	Copyright (C) 13/10/2019 Leonardo Lisa

	This program is free software; you can redistribute it and/or
	modify it under the terms of the GNU General Public License
	as published by the Free Software Foundation; either version 2
	of the License, or (at your option) any later version.
	This program is distributed in the hope that it will be useful,
	but WITHOUT ANY WARRANTY; without even the implied warranty of
	MERCHANTABILITY or FITNESS FOR A PARTICULAR PURPOSE. See the
	GNU General Public License for more details.
	You should have received a copy of the GNU General Public License
	along with this program; if not, write to the Free Software
	Foundation, Inc., 51 Franklin Street, Fifth Floor, Boston, MA 02110-1301,
	USA.
*/

#define clkPin 10
#define dataPin 9

#define FRAME_COUNT 10
#define FRAME_LENGTH 6
#define FRAME_POSITION 12

// Controls pins from bottom to top row.
uint8_t const rowPinsArray[7] = {8, 7, 6, 5, 4, 3, 2};

uint8_t const fontTable[96][7] = { 
   {0x00, 0x00, 0x00, 0x00, 0x00, 0x00, 0x00},   // 0x20, Space 
   {0x04, 0x04, 0x04, 0x04, 0x04, 0x00, 0x04},   // 0x21, ! 
   {0x09, 0x09, 0x12, 0x00, 0x00, 0x00, 0x00},   // 0x22, " 
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   {0x1f, 0x1f, 0x1f, 0x1f, 0x1f, 0x1f, 0x1f}   // 0x7f, DEL 
};

char displayBuffer[19] = " AULA LASER        ";
// IMPORTANT! Fill the messagge buffer with 19 characters; extra characters will be ignored.
char animation1[FRAME_COUNT][FRAME_LENGTH] = {
    "      ",
    "-     ",
    "--    ",
    "---   ",
    "----  ",
    "----- ",
    "-----*",
    "----- ",
    "-----*",
    "-----*"};

unsigned long lastMillis = 0;
uint8_t frame = 0;

void setup()
{
  pinMode(clkPin, OUTPUT);
  pinMode(dataPin, OUTPUT);

  for (uint8_t j = 0; j != 7; j++)
  {
    pinMode(rowPinsArray[j], OUTPUT);
  }
}

void loop()
{
  Animation1();

  // Use a loop or a ISR routine.
  Display();
}

void ShiftOut(uint8_t val)
{
  for (uint8_t i = 0; i < 5; i++)
  {
    digitalWrite(dataPin, !!(val & (1 << i)));
    digitalWrite(clkPin, HIGH);
    digitalWrite(clkPin, LOW);
  }
}

void Display()
{
  // The character is displayed from top to bottom.
  for (uint8_t i = 0; i != 7; i++)
  {
    // All row off.
    for (uint8_t j = 0; j != 7; j++)
    {
      digitalWrite(rowPinsArray[j], HIGH);
    }
    // Starts from the last character.
    for (char c = 18; c >= 0; c--)
    {
      ShiftOut(fontTable[displayBuffer[c] - 32][i]);
    }
    // Row launch, active low.
    digitalWrite(rowPinsArray[i], LOW);
    delayMicroseconds(500);
  }
}

void Animation1()
{
  if (millis() - lastMillis >= 500)
  {
    lastMillis = millis();

    if (frame >= (FRAME_COUNT - 1))
    {
      frame = 0;
    }
    else
    {
      frame++;
    }

    for (uint8_t i = 0; i < FRAME_LENGTH; i++)
    {
      displayBuffer[FRAME_POSITION + i] = animation1[frame][i];
    }
  }
}
